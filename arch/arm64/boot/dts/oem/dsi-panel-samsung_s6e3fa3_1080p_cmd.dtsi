/* Copyright (c) 2014, The Linux Foundation. All rights reserved.
 *
 * This program is free software; you can redistribute it and/or modify
 * it under the terms of the GNU General Public License version 2 and
 * only version 2 as published by the Free Software Foundation.
 *
 * This program is distributed in the hope that it will be useful,
 * but WITHOUT ANY WARRANTY; without even the implied warranty of
 * MERCHANTABILITY or FITNESS FOR A PARTICULAR PURPOSE.  See the
 * GNU General Public License for more details.
 */

/*---------------------------------------------------------------------------
 * This file is autogenerated file using gcdb parser. Please do not edit it.
 * Update input XML file to add a new entry or update variable in this file
 * VERSION = "1.0"
 *---------------------------------------------------------------------------*/
&mdss_mdp {
	dsi_samsung_s6e3fa3_1080p_cmd: qcom,mdss_dsi_samsung_s6e3fa3_1080p_cmd {
		qcom,cont-splash-enabled;
		qcom,mdss-dsi-panel-name = "samsung s6e3fa3 1080p cmd mode dsi panel";
		qcom,mdss-dsi-panel-manufacture = "SAMSUNG";
		qcom,mdss-dsi-panel-version = "S6E3FA3";
		qcom,mdss-dsi-backlight-version = "SAMSUNG";
		qcom,mdss-dsi-backlight-manufacture = "SAMSUNG";
		qcom,mdss-dsi-panel-controller = <&mdss_dsi0>;
		qcom,mdss-dsi-panel-type = "dsi_cmd_mode";
		qcom,mdss-dsi-panel-destination = "display_1";
		qcom,mdss-dsi-panel-framerate = <60>;
		qcom,mdss-dsi-virtual-channel-id = <0>;
		qcom,mdss-dsi-stream = <0>;
		qcom,mdss-dsi-panel-width = <1080>;
		qcom,mdss-dsi-panel-height = <1920>;
		qcom,mdss-dsi-h-front-porch = <120>;
		qcom,mdss-dsi-h-back-porch = <70>;
		qcom,mdss-dsi-h-pulse-width = <19>;
		qcom,mdss-dsi-h-sync-skew = <0>;
		qcom,mdss-dsi-v-back-porch = <4>;
		qcom,mdss-dsi-v-front-porch = <18>;
		qcom,mdss-dsi-v-pulse-width = <2>;
		qcom,mdss-dsi-h-left-border = <0>;
		qcom,mdss-dsi-h-right-border = <0>;
		qcom,mdss-dsi-v-top-border = <0>;
		qcom,mdss-dsi-v-bottom-border = <0>;
		qcom,mdss-dsi-bpp = <24>;
		qcom,mdss-dsi-color-order = "rgb_swap_rgb";
		qcom,mdss-dsi-underflow-color = <0xff>;
		qcom,mdss-dsi-border-color = <0>;
		qcom,mdss-dsi-on-command = [
                05 01 00 00 14 00 02 11 00
                15 01 00 00 00 00 02 35 00
                39 01 00 00 00 00 03 FC 5A 5A
                39 01 00 00 00 00 03 F4 00 01
                39 01 00 00 00 00 03 FC A5 A5
                15 01 00 00 00 00 02 53 20
                15 01 00 00 00 00 02 55 00
                39 01 00 00 00 00 02 57 40
                05 01 00 00 60 00 02 29 00
                ];
		qcom,mdss-dsi-off-command = [05 01 00 00 28 00 02 28 00
					05 01 00 00 A0 00 02 10 00];
		qcom,mdss-dsi-post-panel-on-command = [05 01 00 00 00 00 02 29 00];
		qcom,mdss-dsi-on-command-state = "dsi_lp_mode";
		qcom,mdss-dsi-off-command-state = "dsi_hs_mode";
		qcom,mdss-dsi-h-sync-pulse = <1>;
		qcom,mdss-dsi-traffic-mode = "burst_mode";
		qcom,mdss-dsi-lane-map = "lane_map_0123";
		qcom,mdss-dsi-bllp-eof-power-mode;
		qcom,mdss-dsi-bllp-power-mode;
		qcom,mdss-dsi-lane-0-state;
		qcom,mdss-dsi-lane-1-state;
		qcom,mdss-dsi-lane-2-state;
		qcom,mdss-dsi-lane-3-state;
		qcom,mdss-dsi-panel-timings = [00 1a 06 06 0a 11 05 07 05 03 04 00];
		qcom,mdss-dsi-te-pin-select = <1>;
		qcom,mdss-dsi-te-v-sync-rd-ptr-irq-line = <0x2c>;
		qcom,mdss-dsi-te-v-sync-continue-lines = <0x3c>;
		qcom,mdss-dsi-te-dcs-command = <1>;
		//qcom,esd-check-enabled;
		qcom,mdss-dsi-panel-status-check-mode = "te_signal_check";
		qcom,mdss-dsi-te-check-enable;
		qcom,mdss-dsi-te-using-te-pin;
		qcom,mdss-dsi-t-clk-post = <0x0D>;
		qcom,mdss-dsi-t-clk-pre = <0x30>;
		qcom,mdss-dsi-bl-min-level = <1>;
		qcom,mdss-dsi-bl-max-level = <255>;
		qcom,mdss-dsi-dma-trigger = "trigger_sw";
		qcom,mdss-dsi-mdp-trigger = "trigger_sw";
		qcom,mdss-dsi-bl-pmic-control-type = "bl_ctrl_dcs";
		qcom,mdss-dsi-lp11-init;
		qcom,mdss-dsi-init-delay-us = <60000>;
		qcom,mdss-dsi-reset-sequence = <1 2>,<0 2>, <1 10>;
		/*qcom,mdss-dsi-panel-inverted;*/
		qcom,mdss-pan-physical-width-dimension = <68>;
		qcom,mdss-pan-physical-height-dimension = <122>;
		qcom,mdss-tear-check-frame-rate=<6000>;
		//qcom,mdss-tear-check-sync-cfg-height = <1932>; /* Height + VBP + VFP + VSW */
		//qcom,mdss-tear-check-sync-init-val= <1920>; /* Height */
	  //qcom,mdss-tear-check-sync-threshold-start = <4>;
	  //qcom,mdss-tear-check-sync-threshold-continue = <4>;
	  //qcom,mdss-tear-check-start-pos= <1920>; /* Height */
	  //qcom,mdss-tear-check-rd-ptr-trigger-intr= <1921>; /* Height + 1 */

		qcom,mdss-dsi-high-brightness-panel;

    /* iris mipi mode */
		 qcom,iris-mipitx-type = "dsi_cmd_mode"; /* dsi_video_mode/dsi_cmd_mode */
     qcom,iris-mipirx-channel = <0x1>;    /*dual channel*/
     qcom,iris-mipitx-channel = <0x1>;
     qcom,iris-mipirx-dsc = <0x0>;        /*non DSC*/
     qcom,iris-mipitx-dsc = <0x0>;
     qcom,iris-mipirx-pxl-mode = <0x0>;
     qcom,iris-mipitx-pxl-mode = <0x1>;

     qcom,mdss-dsi-on-command-to-video-panel = [
              05 01 00 00 32 00 02 11 00
              29 01 00 00 00 00 03 F0 5A 5A
              29 01 00 00 00 00 02 B9 01
              29 01 00 00 00 00 03 F0 A5 A5
              29 01 00 00 00 00 03 F0 5A 5A
              29 01 00 00 00 00 03 FC 5A 5A
              29 01 00 00 00 00 03 F4 00 01
              29 01 00 00 00 00 02 C0 32
              29 01 00 00 00 00 02 F7 03
              29 01 00 00 00 00 03 F0 A5 A5
              29 01 00 00 00 00 03 FC A5 A5
              29 01 00 00 00 00 02 53 20
              29 01 00 00 00 00 02 57 40
              29 01 00 00 00 00 02 55 00
              05 01 00 00 10 00 02 29 00
     ];
     qcom,mdss-dsi-on-command-to-video-panel-state = "dsi_lp_mode";

		qcom,mdss-dsi-off-command-to-video-panel = [
			39 01 00 00 32 00 02 28 00
			39 01 00 00 78 00 02 10 00
		];
		qcom,mdss-dsi-off-command-to-video-panel-state = "dsi_hs_mode";

     qcom,mdss-dsi-on-command-to-iris-mipirx = [
              15 01 00 00 01 00 02 3a 77 /* rgb_888 */
              15 01 00 00 01 00 02 35 00 /* set tearing on */
              39 01 00 00 01 00 05 2a 00 00 04 37
              39 01 00 00 01 00 05 2b 00 00 07 7f
     ];
     qcom,mdss-dsi-on-command-to-iris-mipirx-state = "dsi_hs_mode";
    /* iris sys */
		qcom,iris-dpll-clk = <159320400>;
		qcom,iris-dpll0 = <0x2002>;
		qcom,iris-dpll1 = <0x211101>;
		qcom,iris-dpll2 = <0x311687>;
		qcom,iris-ppll1 = <0x211101>;
		qcom,iris-ppll2 = <0xA71A65>;
		qcom,iris-tx-escclk-setting = <0x172>;
		/* iris mipi rx */
		qcom,mipirx-dsi-functional-program = <0x64>;
		qcom,mipirx-data-lane-timing-param = <0xFF08>;
		qcom,mipirx-eot-ecc-crc-disable = <0x7>;
		/* iris2p mipitx */
		qcom,mipitx-dsi-tx-ctrl = <0xA00C139>;
		qcom,mipitx-hs-tx-timer = <0x798D44>;
		qcom,mipitx-bta-lp-timer = <0xFFFF17>;
		qcom,mipitx-initialization-reset-timer = <0xA8C07C7>;
		qcom,mipitx-dphy-timing-margin = <0x40401>;
		qcom,mipitx-lp-timing-para = <0xE010006>;
		qcom,mipitx-data-lane-timing-param1 = <0x120B0F06>;
		qcom,mipitx-clock-lane-timing-param = <0x120A2907>;
		qcom,mipitx-dphy-pll-para = <0x7C7>;
		qcom,mipitx-dphy-trim-1 = <0xEDB5380C>;

		/*iris out timing*/
		qcom,iris-out-panel-width = <1080>;
		qcom,iris-out-panel-height = <1920>;
		qcom,iris-out-h-pulse-width = <19>;
		qcom,iris-out-h-back-porch = <70>;
		qcom,iris-out-h-front-porch = <120>;
		qcom,iris-out-v-pulse-width = <2>;
		qcom,iris-out-v-back-porch = <4>;
		qcom,iris-out-v-front-porch = <134>;
		qcom,iris-delta-period-min = <50>;
		qcom,iris-delta-period-max = <116>;
	};
};
