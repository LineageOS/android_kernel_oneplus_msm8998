/* Copyright (c) 2015-2016, The Linux Foundation. All rights reserved.
 *
 * This program is free software; you can redistribute it and/or modify
 * it under the terms of the GNU General Public License version 2 and
 * only version 2 as published by the Free Software Foundation.
 *
 * This program is distributed in the hope that it will be useful,
 * but WITHOUT ANY WARRANTY; without even the implied warranty of
 * MERCHANTABILITY or FITNESS FOR A PARTICULAR PURPOSE.  See the
 * GNU General Public License for more details.
 */

/{
	cheeseburger_batterydata: qcom,battery-data {
		qcom,batt-id-range-pct = <15>;
		#include "OP-batterydata-3300mah.dtsi"
		#include "fg-gen3-batterydata-itech-3000mah.dtsi"
		#include "fg-gen3-batterydata-ascent-3450mah.dtsi"
		#include "fg-gen3-batterydata-demo-6000mah.dtsi"
	};
};

&pmi8998_fg {
	qcom,battery-data = <&cheeseburger_batterydata>;
	oem,use_external_fg;
	qcom,fg-rsense-sel = <0>;
	qcom,fg-esr-timer-awake = <96>;
	qcom,fg-esr-timer-asleep = <256>;
	qcom,fg-sys-term-current = <190>;
	qcom,fg-chg-term-current = <180>;
};
