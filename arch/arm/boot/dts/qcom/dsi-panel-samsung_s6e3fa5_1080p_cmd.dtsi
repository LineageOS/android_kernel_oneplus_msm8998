/* Copyright (c) 2014, The Linux Foundation. All rights reserved.
 *
 * This program is free software; you can redistribute it and/or modify
 * it under the terms of the GNU General Public License version 2 and
 * only version 2 as published by the Free Software Foundation.
 *
 * This program is distributed in the hope that it will be useful,
 * but WITHOUT ANY WARRANTY; without even the implied warranty of
 * MERCHANTABILITY or FITNESS FOR A PARTICULAR PURPOSE.  See the
 * GNU General Public License for more details.
 */

/*---------------------------------------------------------------------------
 * This file is autogenerated file using gcdb parser. Please do not edit it.
 * Update input XML file to add a new entry or update variable in this file
 * VERSION = "1.0"
 *---------------------------------------------------------------------------*/
&mdss_mdp {
	dsi_samsung_s6e3fa5_1080p_cmd: qcom,mdss_dsi_samsung_s6e3fa5_1080p_cmd {
		qcom,cont-splash-enabled;
		qcom,mdss-dsi-panel-name = "samsung s6e3fa5 1080p cmd mode dsi panel";
		qcom,mdss-dsi-panel-manufacture = "SAMSUNG";
		qcom,mdss-dsi-panel-version = "S6E3FA5";
		qcom,mdss-dsi-backlight-version = "SAMSUNG";
		qcom,mdss-dsi-backlight-manufacture = "SAMSUNG";
		qcom,mdss-dsi-panel-controller = <&mdss_dsi0>;
		qcom,mdss-dsi-panel-type = "dsi_cmd_mode";
		qcom,mdss-dsi-panel-destination = "display_1";
		qcom,mdss-dsi-panel-framerate = <60>;
		qcom,mdss-dsi-virtual-channel-id = <0>;
		qcom,mdss-dsi-stream = <0>;
		qcom,mdss-dsi-panel-width = <1080>;
		qcom,mdss-dsi-panel-height = <1920>;
		qcom,mdss-dsi-h-front-porch = <120>;
		qcom,mdss-dsi-h-back-porch = <70>;
		qcom,mdss-dsi-h-pulse-width = <19>;
		qcom,mdss-dsi-h-sync-skew = <0>;
		qcom,mdss-dsi-v-back-porch = <4>;
		qcom,mdss-dsi-v-front-porch = <18>;
		qcom,mdss-dsi-v-pulse-width = <2>;
		qcom,mdss-dsi-h-left-border = <0>;
		qcom,mdss-dsi-h-right-border = <0>;
		qcom,mdss-dsi-v-top-border = <0>;
		qcom,mdss-dsi-v-bottom-border = <0>;
		qcom,mdss-dsi-bpp = <24>;
		qcom,mdss-dsi-color-order = "rgb_swap_rgb";
		qcom,mdss-dsi-underflow-color = <0xff>;
		qcom,mdss-dsi-border-color = <0>;
		qcom,mdss-dsi-on-command = [
			05 01 00 00 14 00 02 11 00
			15 01 00 00 00 00 02 35 00
			39 01 00 00 00 00 03 F0 5A 5A
			39 01 00 00 00 00 02 B0 04
			39 01 00 00 00 00 04 B4 06 0C 12
			39 01 00 00 00 00 03 F0 A5 A5
			15 01 00 00 00 00 02 53 20
			15 01 00 00 00 00 02 55 00
      39 01 00 00 00 00 03 F0 5A 5A
      39 01 00 00 00 00 02 C3 01
      39 01 00 00 00 00 02 B0 18
      39 01 00 00 00 00 02 C3 00
      39 01 00 00 00 00 03 F0 A5 A5
      ];
		qcom,mdss-dsi-off-command = [05 01 00 00 28 00 02 28 00
					05 01 00 00 A0 00 02 10 00];
		qcom,mdss-dsi-post-panel-on-command = [05 01 00 00 00 00 02 29 00];
		qcom,mdss-dsi-on-command-state = "dsi_lp_mode";
		qcom,mdss-dsi-off-command-state = "dsi_hs_mode";
		qcom,mdss-dsi-h-sync-pulse = <1>;
		qcom,mdss-dsi-traffic-mode = "burst_mode";
		qcom,mdss-dsi-lane-map = "lane_map_0123";
		qcom,mdss-dsi-bllp-eof-power-mode;
		qcom,mdss-dsi-bllp-power-mode;
		qcom,mdss-dsi-lane-0-state;
		qcom,mdss-dsi-lane-1-state;
		qcom,mdss-dsi-lane-2-state;
		qcom,mdss-dsi-lane-3-state;
		qcom,mdss-dsi-panel-timings = [00 1b 06 06 0b 10 06 07 05 03 04 00];
		qcom,mdss-dsi-te-pin-select = <1>;
		qcom,mdss-dsi-te-v-sync-rd-ptr-irq-line = <0x2c>;
		qcom,mdss-dsi-te-v-sync-continue-lines = <0x3c>;
		qcom,mdss-dsi-te-dcs-command = <1>;
		qcom,esd-check-enabled;
		qcom,mdss-dsi-panel-status-check-mode = "te_signal_check";
		qcom,mdss-dsi-te-check-enable;
		qcom,mdss-dsi-te-using-te-pin;
		qcom,mdss-dsi-t-clk-post = <0x07>;
		qcom,mdss-dsi-t-clk-pre = <0x29>;
		qcom,mdss-dsi-bl-min-level = <1>;
		qcom,mdss-dsi-bl-max-level = <255>;
		qcom,mdss-dsi-dma-trigger = "trigger_sw";
		qcom,mdss-dsi-mdp-trigger = "trigger_sw";
		qcom,mdss-dsi-bl-pmic-control-type = "bl_ctrl_dcs";
		qcom,mdss-dsi-lp11-init;
		qcom,mdss-dsi-init-delay-us = <10000>;
		qcom,mdss-dsi-reset-sequence = <1 2>,<0 2>, <1 2>;
		/*qcom,mdss-dsi-panel-inverted;*/
		qcom,mdss-pan-physical-width-dimension = <68>;
		qcom,mdss-pan-physical-height-dimension = <122>;
		qcom,mdss-tear-check-frame-rate=<6000>;
		//qcom,mdss-tear-check-sync-cfg-height = <1932>; /* Height + VBP + VFP + VSW */
		//qcom,mdss-tear-check-sync-init-val= <1920>; /* Height */
	       // qcom,mdss-tear-check-sync-threshold-start = <4>;
	       // qcom,mdss-tear-check-sync-threshold-continue = <4>;
	       // qcom,mdss-tear-check-start-pos= <1920>; /* Height */
	       // qcom,mdss-tear-check-rd-ptr-trigger-intr= <1921>; /* Height + 1 */

		qcom,mdss-dsi-high-brightness-panel;
		qcom,mdss-dsi-panel-acl-command = [15 01 00 00 00 00 02 55 00];
		qcom,mdss-dsi-acl-command-state = "dsi_hs_mode";
		qcom,mdss-dsi-acl-ncmds = <0>;
		qcom,mdss-dsi-acl-npayload = <1>;
		qcom,mdss-dsi-panel-hbm-on-command = [15 01 00 00 00 00 02 53 E8];
		qcom,mdss-dsi-panel-hbm-off-command = [15 01 00 00 00 00 02 53 28];
		qcom,mdss-dsi-hbm-command-state = "dsi_hs_mode";
		/******************************************************************************/
// if you need read the lcd register value you can modify the qcom,mdss-dsi-id-command 
		qcom,mdss-dsi-read-reg-enable-command  = [39 01 00 00 00 00 03 F0 5A 5A];
		qcom,mdss-dsi-read-reg-disable-command = [29 01 00 00 00 00 03 F0 A5 A5];
		qcom,mdss-dsi-packetsizetxcmds-command = [37 01 00 00 00 00 02 07 00];
		qcom,mdss-dsi-readpostxcmds-command =     [15 01 00 00 00 00 02 B0 00];
		qcom,mdss-dsi-id-command = [ 06 01 00 00 00 00 01 C3 0A 19]; //read C3 25~35th , 25=0x19
		qcom,mdss-dsi-packetsizetxcmds-command-state = "dsi_lp_mode";
		qcom,mdss-dsi-readpostxcmds-command-state    = "dsi_lp_mode";
		qcom,mdss-dsi-read-reg-enable-command-state  =  "dsi_lp_mode";
		qcom,mdss-dsi-read-reg-disable-command-state =  "dsi_lp_mode";
		qcom,mdss-dsi-id-command-state = "dsi_lp_mode";

/*****************************************************************************
			qcom,mdss-dsi-panel-srgb-on-command = [
				39 01 00 00 00 00 03 F0 5A 5A
				39 01 00 00 00 00 02 C3 81
				39 01 00 00 00 00 02 B0 18
				39 01 00 00 00 00 02 C3 01
				39 01 00 00 00 00 03 F0 A5 A5
				];
			qcom,mdss-dsi-panel-srgb-off-command = [
				39 01 00 00 00 00 03 F0 5A 5A
				39 01 00 00 00 00 02 C3 01
				39 01 00 00 00 00 02 B0 18
				39 01 00 00 00 00 02 C3 00
				39 01 00 00 00 00 03 F0 A5 A5
				];
			qcom,mdss-dsi-srgb-command-state = "dsi_hs_mode";
*****************************************************************************/ 
			qcom,mdss-dsi-panel-srgb-on-command = [
				39 01 00 00 00 00 03 f0 5A 5A 
				39 01 00 00 00 00 02 C3 81	  
				39 01 00 00 00 00 02 B0 19 
				39 01 00 00 00 00 16 C3 A0 02 04 3B C7 12 08 07 A8 4B E7 C9 BF 0A B9 E3 DA 18 FB F6 DE
				39 01 00 00 00 00 02 B0 18
				39 01 00 00 00 00 02 C3 01
				39 01 00 00 00 00 03 f0 A5 A5

				];
			qcom,mdss-dsi-panel-srgb-off-command = [
				39 01 00 00 00 00 03 F0 5A 5A
				39 01 00 00 00 00 02 C3 01
				39 01 00 00 00 00 02 B0 18
				39 01 00 00 00 00 02 C3 00
				39 01 00 00 00 00 03 F0 A5 A5
				];
			qcom,mdss-dsi-srgb-command-state = "dsi_hs_mode";

			qcom,mdss-dsi-panel-Adobe-rgb-on-command = [
				39 01 00 00 00 00 03 F0 5A 5A
				39 01 00 00 00 00 02 C3 81
				39 01 00 00 00 00 02 B0 18
				39 01 00 00 00 00 02 C3 11
				39 01 00 00 00 00 03 F0 A5 A5
				];
			qcom,mdss-dsi-panel-Adobe-rgb-off-command = [
				39 01 00 00 00 00 03 F0 5A 5A
				39 01 00 00 00 00 02 C3 01
				39 01 00 00 00 00 02 B0 18
				39 01 00 00 00 00 02 C3 00
				39 01 00 00 00 00 03 F0 A5 A5
				];
	
			qcom,mdss-dsi-Adobe-rgb-command-state = "dsi_hs_mode";
	
	/*****************************************************************************
			qcom,mdss-dsi-panel-dci-p3-on-command = [
				39 01 00 00 00 00 03 F0 5A 5A
				39 01 00 00 00 00 02 C3 81
				39 01 00 00 00 00 02 B0 18
				39 01 00 00 00 00 02 C3 21
				39 01 00 00 00 00 03 F0 A5 A5
				];
			qcom,mdss-dsi-panel-dci-p3-off-command = [
				39 01 00 00 00 00 03 F0 5A 5A
				39 01 00 00 00 00 02 C3 01
				39 01 00 00 00 00 02 B0 18
				39 01 00 00 00 00 02 C3 00
				39 01 00 00 00 00 03 F0 A5 A5
				];
			qcom,mdss-dsi-panel-orientation = "180";				
			qcom,mdss-dsi-dci-p3-command-state = "dsi_hs_mode";
	*****************************************************************************/  
			qcom,mdss-dsi-panel-dci-p3-on-command = [
				39 01 00 00 00 00 03 f0 5a 5a 
				39 01 00 00 00 00 02 C3 81	  
				39 01 00 00 00 00 02 B0 19
				39 01 00 00 00 00 16 c3 c6 00 00 16 d2 00 04 08 c3 1c f1 cf e2 02 ce e9 df 00 fb f6 de
				39 01 00 00 00 00 02 B0 18
				39 01 00 00 00 00 02 C3 01
				39 01 00 00 00 00 03 f0 A5 A5

				];
			qcom,mdss-dsi-panel-dci-p3-off-command = [
				39 01 00 00 00 00 03 F0 5A 5A
				39 01 00 00 00 00 02 C3 01
				39 01 00 00 00 00 02 B0 18
				39 01 00 00 00 00 02 C3 00
				39 01 00 00 00 00 03 F0 A5 A5
				];
			qcom,mdss-dsi-panel-orientation = "180";				
			qcom,mdss-dsi-dci-p3-command-state = "dsi_hs_mode";	
/*****************************************************************************/			
			qcom,mdss-dsi-panel-night-mode-on-command = [
				39 01 00 00 00 00 03 f0 5a 5a 
				39 01 00 00 00 00 02 C3 81	  
				39 01 00 00 00 00 02 B0 19
				39 01 00 00 00 00 16 C3 A0 02 04 3B C7 12 08 07 A8 4B E7 C9 BF 0A B9 E3 DA 18 FF FF FF
				39 01 00 00 00 00 02 B0 18
				39 01 00 00 00 00 02 C3 01
				39 01 00 00 00 00 03 f0 A5 A5

				];
			qcom,mdss-dsi-panel-night-mode-off-command = [
				39 01 00 00 00 00 03 F0 5A 5A
				39 01 00 00 00 00 02 C3 01
				39 01 00 00 00 00 02 B0 18
				39 01 00 00 00 00 02 C3 00
				39 01 00 00 00 00 03 F0 A5 A5
				];		
			qcom,mdss-dsi-night-mode-command-state = "dsi_hs_mode";	

			qcom,mdss-dsi-panel-night-mode3500k-on-command = [
				39 01 00 00 00 00 03 f0 5a 5a 
				39 01 00 00 00 00 02 C3 81	  
				39 01 00 00 00 00 02 B0 19
				39 01 00 00 00 00 16 C3 E0 00 03 7A D0 01 07 03 42 90 99 3F F5 05 70 FF AF 01 FF AF 51
				39 01 00 00 00 00 02 B0 18
				39 01 00 00 00 00 02 C3 01
				39 01 00 00 00 00 03 f0 A5 A5

				];
			qcom,mdss-dsi-panel-night-mode3800k-on-command = [
				39 01 00 00 00 00 03 f0 5a 5a 
				39 01 00 00 00 00 02 C3 81	  
				39 01 00 00 00 00 02 B0 19
				39 01 00 00 00 00 16 C3 E0 00 03 7A D0 01 07 03 42 90 99 3F F5 05 70 FF AF 01 FF B9 62
				39 01 00 00 00 00 02 B0 18
				39 01 00 00 00 00 02 C3 01
				39 01 00 00 00 00 03 f0 A5 A5

				];
			qcom,mdss-dsi-panel-night-mode4000k-on-command = [
				39 01 00 00 00 00 03 f0 5a 5a 
				39 01 00 00 00 00 02 C3 81	  
				39 01 00 00 00 00 02 B0 19
				39 01 00 00 00 00 16 C3 E2 02 02 63 D0 01 07 04 5E 6A CF 75 F8 07 8B FC C1 02 FF C3 72
				39 01 00 00 00 00 02 B0 18
				39 01 00 00 00 00 02 C3 01
				39 01 00 00 00 00 03 f0 A5 A5

				];
			qcom,mdss-dsi-panel-night-mode4300k-on-command = [
				39 01 00 00 00 00 03 f0 5a 5a 
				39 01 00 00 00 00 02 C3 81	  
				39 01 00 00 00 00 02 B0 19
				39 01 00 00 00 00 16 C3  E2 02 02 63 D0 01 07 04 5E 6A CF 75 F8 07 8B FC C1 02 FF CA 7E
				39 01 00 00 00 00 02 B0 18
				39 01 00 00 00 00 02 C3 01
				39 01 00 00 00 00 03 f0 A5 A5

				];

			qcom,mdss-dsi-panel-night-mode4500k-on-command = [
				39 01 00 00 00 00 03 f0 5a 5a 
				39 01 00 00 00 00 02 C3 81	  
				39 01 00 00 00 00 02 B0 19
				39 01 00 00 00 00 16 C3 E0 01 02 57 D3 05 08 06 8F 58 C7 80 E4 09 9A EB C4 06 FF D1 88
				39 01 00 00 00 00 02 B0 18
				39 01 00 00 00 00 02 C3 01
				39 01 00 00 00 00 03 f0 A5 A5

				];
			qcom,mdss-dsi-panel-night-mode3100k-on-command = [
				39 01 00 00 00 00 03 f0 5a 5a 
				39 01 00 00 00 00 02 C3 81	  
				39 01 00 00 00 00 02 B0 19
				39 01 00 00 00 00 16 C3 E0 00 03 87 C3 01 07 03 32 90 99 3F F5 05 70 FF AF 01 FF 9A 3E
				39 01 00 00 00 00 02 B0 18
				39 01 00 00 00 00 02 C3 01
				39 01 00 00 00 00 03 f0 A5 A5

				];
			qcom,mdss-dsi-panel-night-mode4800k-on-command = [
				39 01 00 00 00 00 03 f0 5a 5a 
				39 01 00 00 00 00 02 C3 81	  
				39 01 00 00 00 00 02 B0 19
				39 01 00 00 00 00 16 C3 E0 01 02 57 D3 05 08 06 8F 58 C7 80 E4 09 9A EB C4 06 FF D9 97
				39 01 00 00 00 00 02 B0 18
				39 01 00 00 00 00 02 C3 01
				39 01 00 00 00 00 03 f0 A5 A5

				];
			qcom,mdss-dsi-panel-night-mode2800k-on-command = [
				39 01 00 00 00 00 03 f0 5a 5a 
				39 01 00 00 00 00 02 C3 81	  
				39 01 00 00 00 00 02 B0 19
				39 01 00 00 00 00 16 C3 C0 00 01 90 BA 01 07 02 29 90 99 3F F5 05 70 FF AF 01 FF 8B 30
				39 01 00 00 00 00 02 B0 18
				39 01 00 00 00 00 02 C3 01
				39 01 00 00 00 00 03 f0 A5 A5

				];
			qcom,mdss-dsi-panel-night-mode5000k-on-command = [
				39 01 00 00 00 00 03 f0 5a 5a 
				39 01 00 00 00 00 02 C3 81	  
				39 01 00 00 00 00 02 B0 19
				39 01 00 00 00 00 16 C3 DF 01 01 49 C7 08 08 07 AF 50 D3 95 D4 08 A4 DE C4 0A FF DC A0
				39 01 00 00 00 00 02 B0 18
				39 01 00 00 00 00 02 C3 01
				39 01 00 00 00 00 03 f0 A5 A5

				];
			qcom,mdss-dsi-panel-night-mode5500k-on-command = [
				39 01 00 00 00 00 03 f0 5a 5a 
				39 01 00 00 00 00 02 C3 81	  
				39 01 00 00 00 00 02 B0 19
				39 01 00 00 00 00 16 C3 DF 01 01 49 C7 08 08 07 AF 50 D3 95 D4 08 A4 DE C4 0A FF F2 BB
				39 01 00 00 00 00 02 B0 18
				39 01 00 00 00 00 02 C3 01
				39 01 00 00 00 00 03 f0 A5 A5

				];
			qcom,mdss-dsi-panel-night-mode6000k-on-command = [
				39 01 00 00 00 00 03 f0 5a 5a 
				39 01 00 00 00 00 02 C3 81	  
				39 01 00 00 00 00 02 B0 19
				39 01 00 00 00 00 16 C3 F7 02 03 35 AD 0B 06 08 CA 40 C4 A1 C2 0C B5 E0 D3 12 FF F0 CC
				39 01 00 00 00 00 02 B0 18
				39 01 00 00 00 00 02 C3 01
				39 01 00 00 00 00 03 f0 A5 A5

				];
			qcom,mdss-dsi-panel-night-mode6500k-on-command = [
				39 01 00 00 00 00 03 f0 5a 5a 
				39 01 00 00 00 00 02 C3 81	  
				39 01 00 00 00 00 02 B0 19
				39 01 00 00 00 00 16 C3 F7 02 03 35 AD 0B 06 08 CA 40 C4 A1 C2 0C B5 E0 D3 12 FF FD E6
				39 01 00 00 00 00 02 B0 18
				39 01 00 00 00 00 02 C3 01
				39 01 00 00 00 00 03 f0 A5 A5

				];
			qcom,mdss-dsi-panel-night-mode6800k-on-command = [
				39 01 00 00 00 00 03 f0 5a 5a 
				39 01 00 00 00 00 02 C3 81	  
				39 01 00 00 00 00 02 B0 19
				39 01 00 00 00 00 16 C3 D5 03 06 00 BD 07 08 07 AF 00 E1 C3 FC 0B C4 E2 DA 0F FF FD EE
				39 01 00 00 00 00 02 B0 18
				39 01 00 00 00 00 02 C3 01
				39 01 00 00 00 00 03 f0 A5 A5

				];
			qcom,mdss-dsi-panel-night-mode7200k-on-command = [
				39 01 00 00 00 00 03 f0 5a 5a 
				39 01 00 00 00 00 02 C3 81	  
				39 01 00 00 00 00 02 B0 19
				39 01 00 00 00 00 16 C3 A0 02 04 3B C7 12 08 07 A8 4B E7 C9 BF 0A B9 E3 DA 18 FF FE FA
				39 01 00 00 00 00 02 B0 18
				39 01 00 00 00 00 02 C3 01
				39 01 00 00 00 00 03 f0 A5 A5

				];
/**************************************************************************/
			qcom,mdss-dsi-panel-read-mode-on-command = [
				39 01 00 00 00 00 03 f0 5a 5a 
				39 01 00 00 00 00 02 C3 81	  
				39 01 00 00 00 00 02 B0 19
				39 01 00 00 00 00 16 C3 A0 02 04 3B C7 12 08 07 A8 4B E7 C9 BF 0A B9 E3 DA 18 FF FF FF
				39 01 00 00 00 00 02 B0 18
				39 01 00 00 00 00 02 C3 01
				39 01 00 00 00 00 03 f0 A5 A5

				];
			qcom,mdss-dsi-panel-read-mode-off-command = [
				39 01 00 00 00 00 03 F0 5A 5A
				39 01 00 00 00 00 02 C3 01
				39 01 00 00 00 00 02 B0 18
				39 01 00 00 00 00 02 C3 00
				39 01 00 00 00 00 03 F0 A5 A5
				];		
			qcom,mdss-dsi-read-mode-command-state = "dsi_hs_mode";	

	};
/********************************************************************************/

};
