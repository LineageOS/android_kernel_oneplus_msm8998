## drivers/oneplus/Kconfig
```kconfig
config OEM_DEBUG_SUPPORT
        bool "OEM debug support"
        default n

config OEM_TRACE_SUPPORT
	default y
	depends on OEM_DEBUG_SUPPORT
	bool "OEM debug function, enable it will register the device, which under /dev/otracer."
```

## drivers/power/supply/Kconfig
```kconfig
# codeworkx: Use oneplus supply
#source "drivers/power/supply/qcom/Kconfig"
source "drivers/power/supply/qcom_oem/Kconfig"
```
